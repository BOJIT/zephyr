## boards/wch/ch32v307vct6_evt/board.yml
```yaml
board:
  name: ch32v307vct6_evt
  full_name: WCH CH32V307VCT6_EVT
  vendor: wch
  socs:
    - name: ch32v307
```

## drivers/ptp_clock/Kconfig.wch
```kconfig
# Copyright 2025 NXP
# SPDX-License-Identifier: Apache-2.0

config PTP_CLOCK_WCH
	bool "WCH PTP Clock driver"
	default y
	depends on DT_HAS_WCH_PTP_CLOCK_ENABLED
	help
	  Enable WCH PTP clock support.
```

## dts/bindings/ethernet/wch,ch32-ethernet.yaml
```yaml
# Copyright (c) 2025 James Bennion-Pedley <james@bojit.org>
# SPDX-License-Identifier: Apache-2.0

include: [ethernet-controller.yaml, pinctrl-device.yaml]

description: |
  Ethernet MAC Controller for WCH CH32 series MCUs

compatible: "wch,ch32-ethernet"

properties:
  interrupts:
    required: true
  clocks:
    required: true
  pinctrl-0:
    required: true
  pinctrl-names:
    required: true
  phy-connection-type:
    required: true
  phy-handle:
    required: true
```

## dts/bindings/ethernet/wch,ptp-clock.yaml
```yaml
# Copyright 2026 James Bennion-Pedley
# SPDX-License-Identifier: Apache-2.0

description: WCH PTP (Precision Time Protocol) Clock

compatible: "wch,ptp-clock"

include: ["base.yaml", "pinctrl-device.yaml"]
```

## soc/wch/ch32v/Kconfig
```kconfig
# Copyright (c) 2024 Michael Hope
# Copyright (c) 2024 Jianxiong Gu
# SPDX-License-Identifier: Apache-2.0

config SOC_FAMILY_CH32V
	select RISCV
	select BUILD_OUTPUT_HEX
	select CH32V00X_SYSTICK
	select ARCH_HAS_CUSTOM_CPU_IDLE
	select ARCH_HAS_CUSTOM_CPU_ATOMIC_IDLE
	imply XIP

if SOC_FAMILY_CH32V

config VECTOR_TABLE_SIZE
	int "Number of Interrupt and Exception Vectors"
	range 20 256
	help
	  This option defines the total number of interrupt and exception
	  vectors in the vector table.

config SOC_CH32V_CPU_IDLE_GATING
	bool
	help
	  This option determines whether the entering CPU idle mode can be
	  gated by individual drivers. When this option is disabled, CPU idle
	  mode is always permitted.

rsource "*/Kconfig"

endif # SOC_FAMILY_CH32V
```
